## conf/layer.conf
```bitbake
# We have a conf directory, append to BBPATH
BBPATH .= ":${LAYERDIR}"

# We have a recipes directory, add to BBFILES
BBFILES += "\
    ${LAYERDIR}/recipes-*/*/*.bb \
    ${LAYERDIR}/recipes-*/*/*.bbappend \
"

BBFILE_COLLECTIONS += "zenotec"
BBFILE_PATTERN_zenotec := "^${LAYERDIR}/"

# Define the priority for recipes (.bb files) from this layer,
# choosing carefully how this layer interacts with all of the
# other layers.
# 
# openembedded-layer is 6, we want to be well above that.

BBFILE_PRIORITY_zenotec = "25"
LAYERVERSION_zenotec = "1"
```

## conf/machine/include/z-bbb.inc
```bitbake
#@TYPE: Machine
#@NAME: ZenoTec Beaglebone Black custom machine
#@DESCRIPTION: Machine configuration for the ZenoTec customized Beaglebone Black


MACHINE_EXTRA_RRECOMMENDS = " kernel-modules kernel-devicetree"

MACHINE_EXTRA_RDEPENDS += "i2c-tools"

EXTRA_IMAGEDEPENDS += "u-boot"

DEFAULTTUNE ?= "cortexa8hf-neon"
include conf/machine/include/tune-cortexa8.inc

IMAGE_FSTYPES += "tar.bz2"

SERIAL_CONSOLE = "115200 ttyO0"

PREFERRED_PROVIDER_virtual/kernel ?= "linux-yocto"
PREFERRED_VERSION_linux-yocto ?= "3.14%"

KERNEL_IMAGETYPE = "uImage"
KERNEL_EXTRA_ARGS += "LOADADDR=${UBOOT_ENTRYPOINT}"

SPL_BINARY = "MLO"
UBOOT_SUFFIX = "img"
UBOOT_MACHINE = "am335x_evm_config"
UBOOT_ENTRYPOINT = "0x80008000"
UBOOT_LOADADDRESS = "0x80008000"

MACHINE_FEATURES = "usbgadget usbhost vfat alsa"
```

## conf/machine/z-bbb.conf
```bitbake
#@TYPE: Machine
#@NAME: ZenoTec Beaglebone Black custom machine
#@DESCRIPTION: Machine configuration for the ZenoTec customized Beaglebone Black

require conf/machine/include/z-bbb.inc

KERNEL_DEVICETREE = "am335x-z-bbb.dtb"
```

## conf/machine/z-qemu.conf
```bitbake
#@TYPE: Machine
#@NAME: common_pc
#@DESCRIPTION: Machine configuration for running a common x86

require conf/machine/include/z-qemu.inc
```
